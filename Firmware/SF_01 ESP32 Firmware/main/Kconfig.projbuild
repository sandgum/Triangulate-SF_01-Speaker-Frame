## Firmware/SF_01 ESP32 Firmware/main/Kconfig.projbuild
```kconfig
menu "SF_01 Speaker"

    config SF01_BT_DEVICE_NAME
        string "Bluetooth device name"
        default "SF_01 Speaker"
        help
            Name shown in the phone's Bluetooth pairing list.

    config SF01_LED_GPIO
        int "Onboard LED GPIO"
        default 2
        range 0 33
        help
            Pin for the bass visualiser. GPIO2 is where essentially every
            generic ESP32 devkit puts its user LED. Retarget at runtime with
            the `led` shell command if yours differs.

    config SF01_LED_ACTIVE_LOW
        bool "Onboard LED is active low"
        default n
        help
            Some devkits sink the LED to the pin instead of sourcing it.

endmenu
```
